
#include "ssd1306.h"
static I2C_HandleTypeDef *ssd1309_i2c;

static const uint8_t font5x8[][5] = {
    {0x00,0x00,0x00,0x00,0x00}, // ' ' (32)
    {0x00,0x00,0x5F,0x00,0x00}, // '!'
    {0x00,0x07,0x00,0x07,0x00}, // '"'
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    {0x44,0x64,0x54,0x4C,0x44}  // 'z'
};

const unsigned char siklon_logo[]= {
		  0xFF, 0xFF, 0xFF, 0xFF, 0xFF, 0xFF, 0xFF, 0xFF, 0xFF, 0xFF, 0xFF, 0xFF, 0xFF, 0xFF, 0xFF, 0xFF,
		  0xFF, 0xFF, 0xFF, 0xFF, 0xFF, 0xFF, 0xFF, 0xFF, 0xFF, 0xFF, 0xFF, 0xFF, 0xFF, 0xFF, 0xFF, 0xFF,
		  0xFF, 0xFF, 0xFF, 0xFF, 0xFF, 0xFF, 0xFF, 0xFF, 0xFF, 0xFF, 0xFF, 0xFF, 0xFF, 0xFF, 0xFF, 0xFF,
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		  0xFF, 0xFF, 0xFF, 0xFF, 0xFF, 0xFF, 0xFF, 0xFF, 0xFF, 0xFF, 0xFF, 0xFF, 0xFF, 0xFF, 0xFF, 0xFF,
};
/* ==================== PRIVATE FUNCTIONS ==================== */

static void SSD1309_SendCmd(uint8_t cmd)
{
    uint8_t data[2] = {0x00, cmd};
    HAL_I2C_Master_Transmit(ssd1309_i2c, SSD1309_I2C_ADDR, data, 2, HAL_MAX_DELAY);
}

static void SSD1309_SendData(uint8_t dat)
{
    uint8_t data[2] = {0x40, dat};
    HAL_I2C_Master_Transmit(ssd1309_i2c, SSD1309_I2C_ADDR, data, 2, HAL_MAX_DELAY);
}

/* ==================== PUBLIC FUNCTIONS ==================== */

HAL_StatusTypeDef SSD1309_Init(I2C_HandleTypeDef *hi2c)
{
    ssd1309_i2c = hi2c;
    HAL_Delay(100);

    if (HAL_I2C_IsDeviceReady(ssd1309_i2c, SSD1309_I2C_ADDR, 3, 100) != HAL_OK) {
        return HAL_ERROR;
    }

    SSD1309_SendCmd(0xAE);

    SSD1309_SendCmd(0xD5);
    SSD1309_SendCmd(0x80);

    SSD1309_SendCmd(0xA8);
    SSD1309_SendCmd(0x3F);

    SSD1309_SendCmd(0xD3);
    SSD1309_SendCmd(0x00);

    SSD1309_SendCmd(0x40);

    SSD1309_SendCmd(0x8D);
    SSD1309_SendCmd(0x14);

    SSD1309_SendCmd(0x20);
    SSD1309_SendCmd(0x02);

    SSD1309_SendCmd(0xA1);
    SSD1309_SendCmd(0xC8);

    SSD1309_SendCmd(0xDA);
    SSD1309_SendCmd(0x12);

    SSD1309_SendCmd(0x81);
    SSD1309_SendCmd(0xCF);

    SSD1309_SendCmd(0xD9);
    SSD1309_SendCmd(0xF1);

    SSD1309_SendCmd(0xDB);
    SSD1309_SendCmd(0x40);

    SSD1309_SendCmd(0xA4);
    SSD1309_SendCmd(0xA6);

    // CLEAR SEBELUM DISPLAY ON!
    SSD1309_Clear();

    SSD1309_SendCmd(0xAF);  // Display ON

    HAL_Delay(100);

    return HAL_OK;
}

void SSD1309_Clear(void)
{
    uint8_t page, col;
    uint8_t buffer[17];  // 1 control + 16 data bytes

    buffer[0] = 0x40;  // Data mode
    for (uint8_t i = 1; i < 17; i++) {
        buffer[i] = 0x00;
    }

    for (page = 0; page < 8; page++) {
        // Set page address
        SSD1309_SendCmd(0xB0 | page);
        // Set column address to 0
        SSD1309_SendCmd(0x00);
        SSD1309_SendCmd(0x10);

        // Send 128 bytes (8 x 16 bytes)
        for (col = 0; col < 8; col++) {
            HAL_I2C_Master_Transmit(ssd1309_i2c, SSD1309_I2C_ADDR, buffer, 17, HAL_MAX_DELAY);
        }
    }
}

void SSD1309_Fill(void)
{
    uint8_t page, col;
    uint8_t buffer[17];

    buffer[0] = 0x40;
    for (uint8_t i = 1; i < 17; i++) {
        buffer[i] = 0xFF;
    }

    for (page = 0; page < 8; page++) {
        SSD1309_SendCmd(0xB0 | page);
        SSD1309_SendCmd(0x00);
        SSD1309_SendCmd(0x10);

        for (col = 0; col < 8; col++) {
            HAL_I2C_Master_Transmit(ssd1309_i2c, SSD1309_I2C_ADDR, buffer, 17, HAL_MAX_DELAY);
        }
    }
}

void SSD1309_DisplayOn(void)
{
    SSD1309_SendCmd(0x8D);
    SSD1309_SendCmd(0x14);
    SSD1309_SendCmd(0xAF);
}

void SSD1309_DisplayOff(void)
{
    SSD1309_SendCmd(0xAE);
    SSD1309_SendCmd(0x8D);
    SSD1309_SendCmd(0x10);
}

void SSD1309_SetCursor(uint8_t column, uint8_t page)
{
    SSD1309_SendCmd(0xB0 | (page & 0x07));
    SSD1309_SendCmd(0x00 | (column & 0x0F));
    SSD1309_SendCmd(0x10 | ((column >> 4) & 0x0F));
}

void SSD1309_ClearPage(uint8_t page)
{
    uint8_t buffer[17];
    buffer[0] = 0x40;
    for (uint8_t i = 1; i < 17; i++) {
        buffer[i] = 0x00;
    }

    SSD1309_SendCmd(0xB0 | page);
    SSD1309_SendCmd(0x00);
    SSD1309_SendCmd(0x10);

    for (uint8_t col = 0; col < 8; col++) {
        HAL_I2C_Master_Transmit(ssd1309_i2c, SSD1309_I2C_ADDR, buffer, 17, HAL_MAX_DELAY);
    }
}

void SSD1309_ShowChar(uint8_t x, uint8_t page, char chr)
{
    if (chr < 32 || chr > 122) chr = ' ';
    uint8_t c = chr - 32;

    SSD1309_SetCursor(x, page);

    for (uint8_t i = 0; i < 5; i++) {
        SSD1309_SendData(font5x8[c][i]);
    }
    SSD1309_SendData(0x00);  // Spacing
}

void SSD1309_ShowString(uint8_t x, uint8_t page, const char *str)
{
    while (*str) {
        if (x > 122) {
            x = 0;
            page++;
            if (page >= 8) break;
        }
        SSD1309_ShowChar(x, page, *str);
        x += 6;
        str++;
    }
}

void SSD1309_ShowStringCenter(uint8_t page, const char *str)
{
    uint8_t len = 0;
    const char *p = str;
    while (*p++) len++;

    uint8_t start = (128 - (len * 6)) / 2;
    SSD1309_ShowString(start, page, str);
}

void SSD1309_ShowCharScaled(uint8_t x, uint8_t page, char chr, uint8_t scale)
{
    if (scale < 1) scale = 1;
    if (scale > 2) scale = 2;  // Batasi scale max 2

    if (chr < 32 || chr > 122) chr = ' ';
    uint8_t c = chr - 32;

    if (scale == 1) {
        SSD1309_ShowChar(x, page, chr);
        return;
    }

    // Scale 2x
    for (uint8_t i = 0; i < 5; i++) {
        uint8_t fontCol = font5x8[c][i];
        uint16_t stretched = 0;

        // Stretch vertikal: setiap bit jadi 2 bit
        for (uint8_t bit = 0; bit < 8; bit++) {
            if (fontCol & (1 << bit)) {
                stretched |= (3 << (bit * 2));  // 3 = 0b11
            }
        }

        // Tulis ke 2 page
        uint8_t lower = stretched & 0xFF;
        uint8_t upper = (stretched >> 8) & 0xFF;

        // Kolom 1
        SSD1309_SetCursor(x + (i * 2), page);
        SSD1309_SendData(lower);
        SSD1309_SetCursor(x + (i * 2), page + 1);
        SSD1309_SendData(upper);

        // Kolom 2 (duplikat horizontal)
        SSD1309_SetCursor(x + (i * 2) + 1, page);
        SSD1309_SendData(lower);
        SSD1309_SetCursor(x + (i * 2) + 1, page + 1);
        SSD1309_SendData(upper);
    }

    // Spacing
    SSD1309_SetCursor(x + 10, page);
    SSD1309_SendData(0x00);
    SSD1309_SendData(0x00);
    SSD1309_SetCursor(x + 10, page + 1);
    SSD1309_SendData(0x00);
    SSD1309_SendData(0x00);
}

void SSD1309_ShowStringScaled(uint8_t x, uint8_t page, const char *str, uint8_t scale)
{
    while (*str) {
        if (x > 128 - (6 * scale)) break;
        SSD1309_ShowCharScaled(x, page, *str, scale);
        x += 6 * scale;
        str++;
    }
}

void SSD1309_DrawBitmap(const uint8_t *bitmap, uint8_t pages)
{
    for (uint8_t page = 0; page < pages && page < 8; page++) {
        SSD1309_SetCursor(0, page);
        for (uint8_t col = 0; col < 128; col++) {
            SSD1309_SendData(bitmap[page * 128 + col]);
        }
    }
}

/**
 * @brief Clear area tertentu pada satu page
 * @param x      Posisi kolom mulai (0-127)
 * @param page   Page yang akan di-clear (0-7)
 * @param width  Lebar area yang di-clear (dalam pixel)
 */
void SSD1309_ClearArea(uint8_t x, uint8_t page, uint8_t width)
{
    SSD1309_SetCursor(x, page);
    for (uint8_t i = 0; i < width && (x + i) < SSD1309_WIDTH; i++) {
        SSD1309_SendData(0x00);
    }
}

/**
 * @brief Clear area rectangular (multiple pages)
 * @param x      Posisi kolom mulai
 * @param page   Page mulai
 * @param width  Lebar dalam pixel
 * @param pages  Jumlah page yang di-clear
 */
void SSD1309_ClearRect(uint8_t x, uint8_t page, uint8_t width, uint8_t pages)
{
    for (uint8_t p = 0; p < pages && (page + p) < SSD1309_PAGES; p++) {
        SSD1309_SetCursor(x, page + p);
        for (uint8_t i = 0; i < width && (x + i) < SSD1309_WIDTH; i++) {
            SSD1309_SendData(0x00);
        }
    }
}

/**
 * @brief Gambar progress bar
 * @param x       Posisi X
 * @param page    Page
 * @param width   Lebar total bar
 * @param percent Persentase (0-100)
 */
void SSD1309_DrawProgressBar(uint8_t x, uint8_t page, uint8_t width, uint8_t percent)
{
    if (percent > 100) percent = 100;
    uint8_t filled = ((width - 2) * percent) / 100;

    SSD1309_SetCursor(x, page);

    // Border kiri
    SSD1309_SendData(0x7E);

    // Isi bar
    for (uint8_t i = 0; i < width - 2; i++) {
        if (i < filled) {
            SSD1309_SendData(0x7E);  // Filled
        } else {
            SSD1309_SendData(0x42);  // Empty
        }
    }

    // Border kanan
    SSD1309_SendData(0x7E);
}
